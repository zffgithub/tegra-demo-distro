## layers/meta-custom-ros/conf/layer.conf
```bitbake
# We have a conf and classes directory, add to BBPATH
BBPATH .= ":${LAYERDIR}"

# We have recipes-* directories, add to BBFILES
BBFILES += "${LAYERDIR}/recipes-*/*/*.bb \
            ${LAYERDIR}/recipes-*/*/*.bbappend"

BBFILE_COLLECTIONS += "meta-custom-ros"
BBFILE_PATTERN_meta-custom-ros = "^${LAYERDIR}/"
BBFILE_PRIORITY_meta-custom-ros = "6"

LAYERDEPENDS_meta-custom-ros = "core"
LAYERSERIES_COMPAT_meta-custom-ros = "honister"
```
